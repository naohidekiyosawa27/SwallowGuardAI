## firmware/main/Kconfig.projbuild
```kconfig
menu "SWALLOWGUARD research"
config SWALLOWGUARD_SIMULATED
    bool "Simulated bench acquisition only"
    default y
    help
        No human-connected sensors or clinical outputs are implemented.
endmenu
```

## firmware/sdkconfig.defaults
```kconfig
CONFIG_ESPTOOLPY_FLASHSIZE_16MB=y
CONFIG_SPIRAM=y
CONFIG_SPIRAM_MODE_OCT=y
CONFIG_ESP_MAIN_TASK_STACK_SIZE=8192
CONFIG_FREERTOS_HZ=1000
```
